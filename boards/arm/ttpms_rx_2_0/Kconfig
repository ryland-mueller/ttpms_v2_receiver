## boards/arm/ttpms_rx_2_0/Kconfig
```kconfig
config BOARD_ENABLE_DCDC
	bool "DCDC mode"
	select SOC_DCDC_NRF52X
	default y
	depends on BOARD_TTPMS_RX_2_0
```

## boards/arm/ttpms_rx_2_0/Kconfig.board
```kconfig
# Copyright (c) 2023 Nordic Semiconductor ASA
# SPDX-License-Identifier: Apache-2.0

config BOARD_TTPMS_RX_2_0
	bool "TTPMS Receiver V2"
	depends on SOC_NRF52833_QIAA
```

## boards/arm/ttpms_rx_2_0/Kconfig.defconfig
```kconfig
# Copyright (c) 2023 Nordic Semiconductor ASA
# SPDX-License-Identifier: Apache-2.0

if BOARD_TTPMS_RX_2_0

config BOARD
	default "ttpms_rx_2_0"

config BT_CTLR
   default BT

endif
```

## boards/arm/ttpms_rx_2_0/ttpms_rx_2_0_defconfig
```kconfig
# Copyright (c) 2023 Nordic Semiconductor ASA
# SPDX-License-Identifier: Apache-2.0

CONFIG_SOC_SERIES_NRF52X=y
CONFIG_SOC_NRF52833_QIAA=y
CONFIG_BOARD_TTPMS_RX_2_0=y

# Enable MPU
CONFIG_ARM_MPU=y

# Enable hardware stack protection
CONFIG_HW_STACK_PROTECTION=y

# Enable RTT
CONFIG_USE_SEGGER_RTT=y

# enable GPIO
CONFIG_GPIO=y

# additional board options
CONFIG_GPIO_AS_PINRESET=y

CONFIG_PINCTRL=y

# external 32.768KHz crystal provided (default y)
CONFIG_CLOCK_CONTROL_NRF_K32SRC_XTAL=y

# external 32.768KHz crystal accuracy (default 50PPM)
CONFIG_CLOCK_CONTROL_NRF_K32SRC_20PPM=y
```

## nrf52833dk/Kconfig/Kconfig.shield.defconfig
```kconfig
osource "c:/Users/Ryland/Documents/NCS_Projects/boards/shields/*/Kconfig.defconfig"
osource "c:/Users/Ryland/Documents/NCS_Projects/testing_random/boards/shields/*/Kconfig.defconfig"
osource "c:/Users/Ryland/Documents/NCS_Projects/ttpms_v2_receiver/boards/shields/*/Kconfig.defconfig"
osource "C:/ncs/v2.3.0/nrf/boards/shields/*/Kconfig.defconfig"
```
